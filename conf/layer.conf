## conf/layer.conf
```bitbake
# We have a conf and classes directory, add to BBPATH
BBPATH .= ":${LAYERDIR}"

# We have recipes-* directories, add to BBFILES
BBFILES += "${LAYERDIR}/recipes-*/*/*.bb \
    ${LAYERDIR}/recipes-*/*/*.bbappend"

BBFILE_COLLECTIONS += "meta-raspberrypi-delia"
BBFILE_PATTERN_meta-raspberrypi-delia = "^${LAYERDIR}/"
BBFILE_PRIORITY_meta-raspberrypi-delia = "9"
LAYERSERIES_COMPAT_meta-raspberrypi-delia = "hardknott dunfell"
```
